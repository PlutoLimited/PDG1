## main/Kconfig.projbuild
```kconfig
menu "ESP AWS IoT Configuration"

        config AWS_IOT_THING_NAME
        string "AWS IoT Thing Name"
        default "ESP-AWS-IoT-Demo"
        help
            AWS IoT Thing Name

        config AWS_IOT_CLIENT_ID
        string "AWS IoT Client ID"
        default "ESP32-CLIENT"
        help
            AWS IoT Client Name

endmenu
```
